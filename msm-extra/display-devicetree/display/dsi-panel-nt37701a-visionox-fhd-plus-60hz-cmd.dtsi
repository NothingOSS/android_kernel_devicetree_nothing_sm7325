&mdss_mdp {
	dsi_nt37701a_visionox_amoled_60hz_cmd:
		qcom,mdss_dsi_nt37701a_visionox_amoled_60hz_cmd {
		qcom,mdss-dsi-panel-name =
		"nt37701a amoled fhd+ 60hz cmd mode dsi visionox panel";
		qcom,mdss-dsi-panel-type = "dsi_cmd_mode";
		qcom,mdss-dsi-panel-physical-type = "oled";
		qcom,dsi-ctrl-num = <0>;
		qcom,dsi-phy-num = <0>;

		qcom,mdss-dsi-virtual-channel-id = <0>;
		qcom,mdss-dsi-stream = <0>;
		qcom,mdss-dsi-bpp = <24>;
		qcom,mdss-dsi-color-order = "rgb_swap_rgb";
		qcom,mdss-dsi-underflow-color = <0xff>;
		qcom,mdss-dsi-border-color = <0>;
		qcom,mdss-dsi-h-sync-pulse = <0>;
		qcom,mdss-dsi-traffic-mode = "non_burst_sync_event";
		qcom,mdss-dsi-lane-map = "lane_map_0123";
		qcom,mdss-dsi-bllp-eof-power-mode;
		qcom,mdss-dsi-bllp-power-mode;
		qcom,mdss-dsi-tx-eot-append;
		qcom,mdss-dsi-lane-0-state;
		qcom,mdss-dsi-lane-1-state;
		qcom,mdss-dsi-lane-2-state;
		qcom,mdss-dsi-lane-3-state;
		qcom,mdss-dsi-dma-trigger = "trigger_sw";
		qcom,mdss-dsi-mdp-trigger = "none";
		qcom,mdss-dsi-lp11-init;
		qcom,mdss-dsi-reset-sequence = <1 10>, <0 30>, <1 10>;
		qcom,mdss-dsi-te-pin-select = <1>;
		qcom,mdss-dsi-wr-mem-start = <0x2c>;
		qcom,mdss-dsi-wr-mem-continue = <0x3c>;
		qcom,mdss-dsi-te-dcs-command = <1>;
		qcom,mdss-dsi-te-check-enable;
		qcom,mdss-dsi-te-using-te-pin;
		qcom,mdss-dsi-display-timings {
			timing@0 {
				qcom,mdss-dsi-panel-width = <1080>;
				qcom,mdss-dsi-panel-height = <2400>;
				qcom,mdss-dsi-h-front-porch = <100>;
				qcom,mdss-dsi-h-back-porch = <92>;
				qcom,mdss-dsi-h-pulse-width = <8>;
				qcom,mdss-dsi-h-sync-skew = <0>;
				qcom,mdss-dsi-v-back-porch = <16>;
				qcom,mdss-dsi-v-front-porch = <20>;
				qcom,mdss-dsi-v-pulse-width = <4>;
				qcom,mdss-dsi-panel-framerate = <60>;
				qcom,mdss-dsi-on-command = [
						39 01 00 00 00 00 06 F0 55 AA 52 08 08
						15 01 00 00 00 00 03 C0 8F 7F
						15 01 00 00 00 00 02 5F 00
						39 01 00 00 00 00 06 F0 55 AA 52 08 08
						39 01 00 00 00 00 11 B6 0F FE 0F FE 0F FE 0F FE 0F FE 0F FE 0F FE 0F FE
						15 01 00 00 00 00 02 6F 10
						39 01 00 00 00 00 11 B6 0F FE 0F FE 0F FE 0F FE 0F FE 0F FE 0F FE 0F FE
						15 01 00 00 00 00 02 6F 20
						39 01 00 00 00 00 07 B6 0F FE 0F FE 0F FE
						39 01 00 00 00 00 11 B7 08 00 08 00 08 00 08 00 08 00 08 00 08 00 08 00
						15 01 00 00 00 00 02 6F 10
						39 01 00 00 00 00 11 B7 08 00 08 00 08 00 08 00 08 00 08 00 08 00 08 00
						15 01 00 00 00 00 02 6F 20
						39 01 00 00 00 00 07 B7 08 00 08 00 08 00
						39 01 00 00 00 00 11 B8 08 00 08 00 08 00 08 00 08 00 08 00 08 00 08 00
						15 01 00 00 00 00 02 6F 10
						39 01 00 00 00 00 11 B8 08 00 08 00 08 00 08 00 08 00 08 00 08 00 08 00
						15 01 00 00 00 00 02 6F 20
						39 01 00 00 00 00 07 B8 08 00 08 00 08 00
						39 01 00 00 00 00 11 B9 01 01 00 91 00 38 60 00 E6 00 41 00 00 00 00 00
						15 01 00 00 00 00 02 6F 10
						39 01 00 00 00 00 11 B9 00 00 00 00 00 00 00 00 00 00 01 00 14 00 3E 00
						15 01 00 00 00 00 02 6F 20
						39 01 00 00 00 00 11 B9 8C 02 03 04 00 05 FE 07 FC 09 FA 0B F8 00 00 00
						15 01 00 00 00 00 02 6F 30
						39 01 00 00 00 00 11 B9 00 00 00 00 00 00 00 00 00 00 00 00 00 00 00 00
						15 01 00 00 00 00 02 6F 40
						39 01 00 00 00 00 11 B9 17 00 B9 01 5C 01 FF 02 A2 03 45 03 E8 04 8B 00
						15 01 00 00 00 00 02 6F 50
						39 01 00 00 00 00 11 B9 00 00 00 00 00 00 00 00 00 00 00 00 00 00 00 00
						15 01 00 00 00 00 02 6F 60
						39 01 00 00 00 00 11 B9 03 00 58 01 2D 02 C8 04 6B 07 15 09 BF 0C 69 0E
						15 01 00 00 00 00 02 6F 70
						39 01 00 00 00 00 11 B9 FC 02 00 00 00 01 80 80 80 80 80 80 80 80 80 80
						15 01 00 00 00 00 02 6F 80
						39 01 00 00 00 00 11 B9 80 80 80 80 80 80 80 80 80 80 80 80 80 80 80 80
						15 01 00 00 00 00 02 6F 90
						39 01 00 00 00 00 11 B9 80 80 80 80 80 80 80 80 80 80 80 80 80 80 80 80
						15 01 00 00 00 00 02 6F A0
						39 01 00 00 00 00 11 B9 80 80 80 80 80 80 80 80 80 80 80 80 80 80 80 80
						15 01 00 00 00 00 02 6F B0
						39 01 00 00 00 00 11 B9 80 80 80 80 80 80 80 80 80 80 80 80 80 80 80 80
						15 01 00 00 00 00 02 6F C0
						39 01 00 00 00 00 11 B9 80 80 80 80 80 80 80 80 80 80 80 80 80 80 80 80
						15 01 00 00 00 00 02 6F D0
						39 01 00 00 00 00 11 B9 80 80 80 80 80 80 80 80 80 80 80 80 80 80 80 80
						15 01 00 00 00 00 02 6F E0
						39 01 00 00 00 00 11 B9 80 80 80 80 80 80 80 80 80 80 80 80 80 80 80 80
						15 01 00 00 00 00 02 6F F0
						39 01 00 00 00 00 0E B9 80 80 80 80 80 80 80 80 80 80 80 80 80
						39 01 00 00 00 00 11 BA 02 00 02 00 02 00 02 00 02 00 02 00 02 00 02 00
						15 01 00 00 00 00 02 6F 10
						39 01 00 00 00 00 11 BA 02 00 02 00 02 00 02 00 02 00 02 00 02 00 02 00
						15 01 00 00 00 00 02 6F 20
						39 01 00 00 00 00 11 BA 02 00 02 00 02 00 02 00 02 00 02 00 02 00 02 00
						15 01 00 00 00 00 02 6F 30
						39 01 00 00 00 00 11 BA 02 00 02 00 02 00 02 00 02 00 02 00 02 00 02 00
						15 01 00 00 00 00 02 6F 40
						39 01 00 00 00 00 11 BA 02 00 02 00 02 00 02 00 02 00 02 00 02 00 02 00
						15 01 00 00 00 00 02 6F 50
						39 01 00 00 00 00 11 BA 02 00 02 00 02 00 02 00 02 00 02 00 02 00 02 00
						15 01 00 00 00 00 02 6F 60
						39 01 00 00 00 00 11 BA 02 00 02 00 02 00 02 00 05 D1 08 00 08 00 08 00
						15 01 00 00 00 00 02 6F 70
						39 01 00 00 00 00 11 BA 08 00 08 00 08 00 08 00 08 00 08 00 08 00 08 00
						15 01 00 00 00 00 02 6F 80
						39 01 00 00 00 00 11 BA 08 00 05 3F 07 36 07 36 07 36 07 36 07 36 07 36
						15 01 00 00 00 00 02 6F 90
						39 01 00 00 00 00 11 BA 07 36 07 36 08 00 08 00 08 00 08 00 05 3F 07 36
						15 01 00 00 00 00 02 6F A0
						39 01 00 00 00 00 11 BA 07 36 07 36 07 36 07 36 07 36 07 36 07 36 08 00
						15 01 00 00 00 00 02 6F B0
						39 01 00 00 00 00 11 BA 08 00 08 00 08 00 05 D1 08 00 08 00 08 00 08 00
						15 01 00 00 00 00 02 6F C0
						39 01 00 00 00 00 11 BA 08 00 08 00 08 00 08 00 08 00 08 00 08 00 08 00
						15 01 00 00 00 00 02 6F D0
						39 01 00 00 00 00 11 BA 08 00 08 00 08 00 08 00 08 00 08 00 08 00 08 00
						15 01 00 00 00 00 02 6F E0
						39 01 00 00 00 00 0B BA 08 00 08 00 08 00 08 00 08 00
						39 01 00 00 00 00 11 BB 00 64 00 64 00 64 00 64 00 64 00 64 00 64 00 64
						15 01 00 00 00 00 02 6F 10
						39 01 00 00 00 00 11 BB 00 64 01 00 01 00 01 00 01 00 00 64 00 64 00 64
						15 01 00 00 00 00 02 6F 20
						39 01 00 00 00 00 11 BB 00 64 00 64 00 64 00 64 00 64 00 64 01 00 01 00
						15 01 00 00 00 00 02 6F 30
						39 01 00 00 00 00 11 BB 01 00 01 00 00 64 00 64 00 64 00 64 00 64 00 64
						15 01 00 00 00 00 02 6F 40
						39 01 00 00 00 00 11 BB 00 64 00 64 00 64 01 00 01 00 01 00 01 00 00 64
						15 01 00 00 00 00 02 6F 50
						39 01 00 00 00 00 11 BB 00 64 00 64 00 64 00 64 00 64 00 64 00 64 00 64
						15 01 00 00 00 00 02 6F 60
						39 01 00 00 00 00 11 BB 01 00 01 00 01 00 01 00 01 00 01 00 01 00 01 00
						15 01 00 00 00 00 02 6F 70
						39 01 00 00 00 00 11 BB 01 00 01 00 01 00 01 00 01 00 01 00 01 00 01 00
						15 01 00 00 00 00 02 6F 80
						39 01 00 00 00 00 11 BB 01 00 08 00 00 00 00 00 00 00 00 00 00 00 00 00
						15 01 00 00 00 00 02 6F 90
						39 01 00 00 00 00 11 BB 00 00 00 00 00 00 00 00 00 00 00 00 00 0B 09 0C
						15 01 00 00 00 00 02 6F A0
						39 01 00 00 00 00 09 BB 91 C2 A1 00 00 00 08 00
						39 01 00 00 00 00 05 E9 00 00 00 2D
						39 01 00 00 00 00 11 EE 05 00 00 00 00 00 00 0F FE 08 00 08 00 08 00 08
						15 01 00 00 00 00 02 6F 10
						39 01 00 00 00 00 10 EE 00 08 00 08 00 08 00 08 00 08 00 08 00 0F FE
						39 01 00 00 00 00 05 FF AA 55 A5 80
						15 01 00 00 00 00 02 6F 61
						15 01 00 00 00 00 02 F3 80
						15 01 00 00 00 00 02 6F 1D
						15 01 00 00 00 00 02 F2 05
						39 01 00 00 00 00 06 F0 55 AA 52 00 00
						39 01 00 00 00 00 05 FF AA 55 A5 00
						15 01 00 00 00 00 02 03 01
						15 01 00 00 00 00 02 90 11
						39 01 00 00 00 00 13 91 89 28 00 14 C2 00 02 0E 01 E8 00 07 05 0E 05 16 10 F0
						05 01 00 00 00 00 01 2C
						15 01 00 00 00 00 02 2F 01
						15 01 00 00 00 00 02 26 01
						39 01 00 00 00 00 05 51 0D BB 0F FE
						15 01 00 00 00 00 02 53 20
						15 01 00 00 00 00 02 35 00
						39 01 00 00 00 00 05 2A 00 00 04 37
						39 01 00 00 00 00 05 2B 00 00 09 5F
						39 01 00 00 00 00 05 3B 00 10 00 14
						05 01 00 00 46 00 02 11 00
						05 01 00 00 32 00 02 29 00];
				qcom,mdss-dsi-off-command = [
						05 01 00 00 32 00 02 28 00
						05 01 00 00 46 00 02 10 00];
				qcom,mdss-dsi-on-command-state = "dsi_lp_mode";
				qcom,mdss-dsi-off-command-state = "dsi_hs_mode";
				qcom,mdss-dsi-h-sync-pulse = <0>;
				qcom,compression-mode = "dsc";
				qcom,mdss-dsc-slice-height = <20>;
				qcom,mdss-dsc-slice-width = <540>;
				qcom,mdss-dsc-slice-per-pkt = <2>;
				qcom,mdss-dsc-bit-per-component = <8>;
				qcom,mdss-dsc-bit-per-pixel = <8>;
				qcom,mdss-dsc-block-prediction-enable;
			};
		};
	};
};
