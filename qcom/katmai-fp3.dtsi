#include "yupik-iot.dtsi"
#include "katmai-cpu-fp2p5.dtsi"

/ {
	model = "Qualcomm Technologies, Inc. KATMAI-FP3 SoC";
	compatible = "qcom,yupik-iot";
	qcom,msm-id = <576 0x10000>;
	qcom,softsku-id = <3>;
};

&mdss_dsi0 {
	/delete-property/reg;
	/delete-property/reg-names;

	reg = <0xae94000 0x400>,
		<0xaf08000 0x4>,
		<0x0ae36000 0x300>,
		<0xc00c6000 0x01000>;
	reg-names = "dsi_ctrl", "disp_cc_base", "mdp_intf_base", "disp_conf";
};
