#include "katmai-fp2p5.dtsi"

/ {
	model = "Qualcomm Technologies, Inc. KATMAIP-FP2P5 SoC";
	compatible = "qcom,yupikp-iot";
	qcom,msm-id = <575 0x10000>;
	qcom,softsku-id = <8>;
};

&mdss_dsi0 {
	/delete-property/reg;
	/delete-property/reg-names;

	reg = <0xae94000 0x400>,
		<0xaf08000 0x4>,
		<0x0ae36000 0x300>,
		<0xc00c6000 0x01000>;
	reg-names = "dsi_ctrl", "disp_cc_base", "mdp_intf_base", "disp_conf";
};
