/dts-v1/;
/plugin/;

#include "yupik-qrd-pm7250b.dtsi"

/ {
	model = "Qualcomm Technologies, Inc. Yupik QRD + PM7250B";
	compatible = "qcom,yupik-idp", "qcom,yupik", "qcom,qrd";
	qcom,msm-id = <475 0x10000>, <515 0x10000>;
	qcom,board-id = <0x1000B 0>;
};