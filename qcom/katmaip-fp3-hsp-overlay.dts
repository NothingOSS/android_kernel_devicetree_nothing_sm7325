/dts-v1/;
/plugin/;

#include <dt-bindings/interconnect/qcom,yupik.h>
#include "katmaip-hsp.dtsi"

/ {
	model = "Qualcomm Technologies, Inc. KatmaiP FP3 IoT HSP";
	compatible = "qcom,yupikp-iot-idp", "qcom,yupikp-iot", "qcom,idp";
	qcom,msm-id = <498 0x10000>, <575 0x10000>, <576 0x10000>;
	qcom,board-id = <34 1>;
	qcom,softsku-id = <3>;
};

&pcie1 {
	status = "ok";
};

&pcie1_msi {
	status = "ok";
};
