/* Reserved for bootloader log memory according to xbl uefiplat.cfg*/
&soc {
	bootloader_log {
		compatible = "nothing,bootloader_log";
		memory-region = <&reserved_xbl_uefi>;
		log,offset_size = <0x4000 0x100000>;
	};
};

// 0x83A00000 reaseved for ramoops
&qcom {
	reg = <0x0 0x83A00000 0x0 0x400000>;
	console-size = <0x200000>;
	pmsg-size = <0x200000>;
};
