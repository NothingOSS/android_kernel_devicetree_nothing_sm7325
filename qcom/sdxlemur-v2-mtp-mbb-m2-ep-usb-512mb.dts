/dts-v1/;

#include "sdxlemur-mtp-mbb-m2-512mb.dtsi"
#include "sdxlemur-mtp-mbb-m2-ep-usb.dtsi"

/ {
	model = "Qualcomm Technologies, Inc. SDXLEMUR MTP MBB M2 EP USB V2 512MB";
	compatible = "qcom,sdxlemur-mtp",
		"qcom,sdxlemur", "qcom,mtp";
	qcom,board-id = <0x14010008 0x214>;
};
